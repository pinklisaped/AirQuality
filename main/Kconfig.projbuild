## main/Kconfig.projbuild
```kconfig
menu "PM Sensor Configuration"
    choice SENSOR_TYPE
        prompt "Select Particulate Matter Sensor"
        default USE_PMS5003

        config USE_PMS5003
            bool "PMS5003"
        config USE_SPS30
            bool "SPS30"
    endchoice
endmenu
```
